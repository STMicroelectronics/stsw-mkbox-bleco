## ble_fw_upg_app/sample.yaml
```yaml
sample:
  description: Application used to upgrade ble f/w on sensortile boards
  name: ble-fw-upgrade 
common:
  build_only: true
  integration_platforms:
    - sensortile_box_pro
tests:
  app.default: {}
  app.debug:
    extra_overlay_confs:
      - debug.conf
```
